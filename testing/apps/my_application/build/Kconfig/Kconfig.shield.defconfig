## testing/apps/my_application/build/Kconfig/Kconfig.shield.defconfig
```kconfig
osource "D:/Desktop/source/testing/apps/my_application/../..//boards/shields/*/Kconfig.defconfig"
```

## testing/apps/threading/build/Kconfig/Kconfig.shield
```kconfig
osource "D:/Desktop/source/led_blink/apps/threading/../..//boards/shields/*/Kconfig.shield"
```

## testing/boards/arm/blue_pill/Kconfig.board
```kconfig
# Copyright (c) 2023 Quasal
# SPDX-License-Identifier: Apache-2.0

config BOARD_STM32F103C8T6
    bool "stm32f103C8T6"
    depends on SOC_STM32F103XE
```

## testing/boards/arm/blue_pill/Kconfig.defconfig
```kconfig
# Copyright (c) 2023 Quasal
# SPDX-License-Identifier: Apache-2.0

if BOARD_STM32F103C8T6

config BOARD
    default "blue_pill"

endif # BOARD_STM32F103C8T6

config SLEEP_TIME_MS
    int "Sleep time between led states (millisec)"
    default 1000
    help
      This option sets the sleep time between led states in millisec.
```

## testing/boards/arm/blue_pill/blue_pill_defconfig
```kconfig
# SPDX-License-Identifier: Apache-2.0

CONFIG_SOC_SERIES_STM32F1X=y
CONFIG_SOC_STM32F103XE=y

# enable pin controller
CONFIG_PINCTRL=y

# enable GPIO
CONFIG_GPIO=y

# enable RCC clock control
CONFIG_CLOCK_CONTROL=y
```
